## base_external/configs/aesd_qemu_defconfig
```kconfig
BR2_PACKAGE_DROPBEAR=y
BR2_PACKAGE_AESD_ASSIGNMENTS=y
BR2_TARGET_GENERIC_ROOT_PASSWD="root"
```

## base_external/package/raspi-scripts/Config.in
```kconfig
config BR2_PACKAGE_RASPI_SCRIPTS
	bool "raspi-scripts"
	help
	  Includes the camera driver scripts for Raspberry Pi.
```
